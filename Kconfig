## Kconfig
```kconfig
menu "simple_pushota"

config SIMPLE_PUSHOTA_ENABLED
    bool "Enable"

config SIMPLE_PUSHOTA_GETVERSION
    bool "Provide GET endpoint for version query"
    depends on SIMPLE_PUSHOTA_ENABLED
    help
        Enabling this adds an interface to query the current firmware
        version through an HTTP GET request.

config SIMPLE_PUSHOTA_PORT
    int "Push OTA remote port"
    depends on SIMPLE_PUSHOTA_ENABLED
    default 8888

endmenu
```
